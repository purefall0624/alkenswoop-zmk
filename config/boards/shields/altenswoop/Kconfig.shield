## config/boards/shields/altenswoop/Kconfig.shield
```kconfig
# Copyright (c) 2022 Duccio Breschi
# SPDX-License-Identifier: MIT

config SHIELD_ALTENSWOOP_LEFT
    def_bool $(shields_list_contains,altenswoop_left)

config SHIELD_ALTENSWOOP_RIGHT
    def_bool $(shields_list_contains,altenswoop_right)
```
